## tools/payload_tool/Kconfig
```kconfig
menu "Payload Tool Configuration"

    config PAYLOAD_USE_SERVER_FORMAT
        bool "Use server-compatible format"
        default y
        help
            Use the server-compatible rfid_poll_result format instead of the legacy
            session/device/metadata format. This enables Pydantic validation compliance
            with the webhook server.

    config PAYLOAD_MINIMAL_MODE
        bool "Minimal payload mode"
        default n
        help
            Include only the core required fields for server validation.
            Reduces payload size but removes diagnostic information.

    config PAYLOAD_INCLUDE_DIAGNOSTICS
        bool "Include diagnostic fields"
        default y
        depends on !PAYLOAD_MINIMAL_MODE
        help
            Include supplemental diagnostic fields like memory usage, uptime,
            event confidence, and processing time for server-side analysis.

    config PAYLOAD_INCLUDE_NETWORK_INFO
        bool "Include network information"
        default y
        depends on !PAYLOAD_MINIMAL_MODE
        help
            Include WiFi signal strength and connection status information
            for network quality monitoring.

    config PAYLOAD_TIMESTAMP_FORMAT
        int "Timestamp format"
        range 0 2
        default 1
        help
            Timestamp format to use in payloads:
            0 = Unix timestamp (microseconds)
            1 = ISO 8601 format (YYYY-MM-DDTHH:MM:SS)
            2 = ISO 8601 with timezone (YYYY-MM-DDTHH:MM:SS+TZ)

    config PAYLOAD_EVENT_CONFIDENCE_THRESHOLD
        int "Event confidence threshold"
        range 0 100
        default 95
        help
            Minimum event confidence percentage (0-100) for valid events.
            Events below this threshold will be marked with lower confidence.

    config PAYLOAD_SESSION_ID_FORMAT
        int "Session ID format"
        range 0 2
        default 0
        help
            Session ID generation format:
            0 = Simple timestamp + tag (sess_1234567890_TAG)
            1 = UUID4 format
            2 = Custom format with device ID

    config PAYLOAD_MAX_PAYLOAD_SIZE
        int "Maximum payload size"
        range 512 2048
        default 1024
        help
            Maximum size in bytes for JSON payload buffer.
            Larger payloads support more diagnostic information.

endmenu
```

## tools/webhook_tool/Kconfig
```kconfig
menu "Webhook Tool Configuration"

    config WEBHOOK_TOOL_DEFAULT_URL
        string "Default webhook URL"
        default "https://api.example.com/webhook"
        help
            Default webhook URL for sending events. Can be overridden at runtime.

    config WEBHOOK_TOOL_MAX_RETRIES
        int "Maximum retry attempts"
        default 3
        range 0 10
        help
            Maximum number of retry attempts for failed webhook requests.

    config WEBHOOK_TOOL_RETRY_DELAY_MS
        int "Retry delay (milliseconds)"
        default 5000
        range 1000 60000
        help
            Delay between retry attempts in milliseconds.

    config WEBHOOK_TOOL_REQUEST_TIMEOUT_MS
        int "Request timeout (milliseconds)"
        default 30000
        range 5000 120000
        help
            HTTP request timeout in milliseconds.

    config WEBHOOK_TOOL_MAX_QUEUE_SIZE
        int "Maximum event queue size"
        default 50
        range 10 200
        help
            Maximum number of events that can be queued for processing.

    config WEBHOOK_TOOL_TASK_STACK_SIZE
        int "Task stack size"
        default 4096
        range 2048 8192
        help
            Stack size for the webhook processing task.

    config WEBHOOK_TOOL_ENABLE_PERSISTENT_QUEUE
        bool "Enable persistent event queue"
        default y
        help
            Save unprocessed events to filesystem for retry after restart.

    config WEBHOOK_TOOL_LOG_RETENTION_HOURS
        int "Log retention period (hours)"
        default 168
        range 24 720
        help
            How long to keep event logs before cleanup (168 hours = 1 week).

endmenu
```
