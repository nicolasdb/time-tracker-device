## Kconfig
```kconfig
menu "Time Tracker Configuration"
    source "components/fs_manager/Kconfig"
    source "components/webhook_manager/Kconfig"
    source "components/feedback_manager/Kconfig.projbuild"
endmenu
```

## Kconfig.projbuild
```kconfig
menu "Time Tracker Device Configuration"

    # Include Feedback Tool Configuration
    source "$PROJECT_PATH/tools/feedback_tool/Kconfig"

    # Include RFID Tool Configuration
    source "$PROJECT_PATH/tools/rfid_tool/Kconfig"

    # Include Filesystem Tool Configuration
    source "$PROJECT_PATH/tools/fs_tool/Kconfig"

    # Include NTP Tool Configuration
    source "$PROJECT_PATH/tools/ntp_tool/Kconfig"

    # Include Payload Tool Configuration
    source "$PROJECT_PATH/tools/payload_tool/Kconfig"

    # Include Webhook Tool Configuration
    source "$PROJECT_PATH/tools/webhook_tool/Kconfig"

endmenu
```

## components/feedback_manager/Kconfig.projbuild
```kconfig
menu "Feedback Manager Configuration"
    config FEEDBACK_LED_GPIO
        int "LED GPIO Number"
        default 7
        help
            GPIO number (IOxx) where WS2812B NeoPixel LED is connected.

    config FEEDBACK_USE_WS2812
        bool "Use WS2812B NeoPixel"
        default y
        help
            If enabled, feedback uses WS2812B NeoPixel LED with RGB values.
            If disabled, feedback uses standard GPIO LED.
            
    config FEEDBACK_LED_BRIGHTNESS
        int "LED Brightness (0-255)"
        default 10
        range 1 255
        depends on FEEDBACK_USE_WS2812
        help
            Brightness level for the WS2812B LED (1-255).
            Lower values consume less power and can be easier on the eyes.
endmenu
```

## components/fs_manager/Kconfig
```kconfig
menu "Filesystem Manager Configuration"

    config FS_MANAGER_MOUNT_POINT
        string "Filesystem Mount Point"
        default "/littlefs"
        help
            Mount point for LittleFS filesystem.

    config FS_MANAGER_FORMAT_IF_MOUNT_FAILED
        bool "Format filesystem if mount failed"
        default y
        help
            Enable automatic formatting if mounting fails.

    config FS_MANAGER_MAX_FILE_SIZE
        int "Maximum file size (KB)"
        default 64
        range 4 1024
        help
            Maximum size for files in KB.

endmenu
```

## components/fs_manager/Kconfig.projbuild
```kconfig
menu "LittleFS Configuration"

    config LITTLEFS_OBJ_NAME_LEN
        int "Maximum length of LittleFS object name"
        default 64
        help
            Maximum length of name of objects (files or directories) in LittleFS.
            
endmenu
```

## components/webhook_manager/Kconfig
```kconfig
menu "Webhook Manager Configuration"

config WEBHOOK_MANAGER_URL
    string "Default webhook URL"
    default "http://localhost/webhook"
    help
        The default URL to which webhook events will be sent.

config WEBHOOK_MANAGER_MAX_RETRIES
    int "Default maximum retry attempts"
    default 3
    help
        The number of times the webhook manager will retry sending a failed event.

config WEBHOOK_MANAGER_RETRY_DELAY_MS
    int "Default retry delay (ms)"
    default 5000
    help
        The delay in milliseconds between retry attempts for failed webhook events.

config WEBHOOK_MANAGER_MAX_LOG_ENTRIES
    int "Maximum number of log entries"
    default 50
    help
        The maximum number of webhook events that can be stored in the log.

config WEBHOOK_MANAGER_DEBUG
    bool "Enable debug logs"
    default n
    help
        Enable additional debug logging for webhook operations.

endmenu
```

## legacy/components_old/feedback_manager/Kconfig.projbuild
```kconfig
menu "Feedback Manager Configuration"
    config FEEDBACK_LED_GPIO
        int "LED GPIO Number"
        default 7
        help
            GPIO number (IOxx) where WS2812B NeoPixel LED is connected.
            
    config FEEDBACK_LED_BRIGHTNESS
        int "LED Brightness (1-255)"
        default 150
        range 1 255
        help
            Brightness level for the WS2812B LED (1-255).
            Higher values provide better visibility for breathing effects.
            150 is recommended for good visibility while avoiding eye strain.
            
    config FEEDBACK_BREATHING_PERIOD
        int "Breathing Effect Period (cycles)"
        default 40
        range 20 100
        help
            Number of cycles for one complete breathing period.
            Higher values = slower breathing effect.
            
    config FEEDBACK_LOG_LEVEL
        int "Feedback Manager Log Level"
        default 2
        range 0 5
        help
            0=None, 1=Error, 2=Warn, 3=Info, 4=Debug, 5=Verbose
endmenu
```

## legacy/components_old/rfid_manager/Kconfig
```kconfig
menu "RFID Configuration"

    choice RFID_MODULE_TYPE
        prompt "RFID Module Type"
        default RFID_MODULE_RC522
        help
            Select the RFID module type to use.

        config RFID_MODULE_RC522
            bool "RC522 (SPI)"
            help
                Use RC522 RFID module with SPI interface.

        config RFID_MODULE_PN532
            bool "PN532 (SPI/I2C)"
            depends on EXPERIMENTAL
            help
                Use PN532 RFID/NFC module with SPI or I2C interface.
                (Not yet implemented)
    endchoice

    config RFID_RST_GPIO
        int "Reset GPIO pin"
        range -1 48
        default 9
        help
            GPIO pin for RFID module reset. Use -1 for soft reset.

    if RFID_MODULE_RC522
        config RFID_RC522_SPI_HOST
            int "SPI Host"
            range 0 2
            default 2
            help
                SPI host to use (SPI2_HOST = 2).

        config RFID_RC522_SPI_MISO
            int "MISO GPIO pin"
            range 0 48
            default 5
            help
                GPIO pin for SPI MISO.

        config RFID_RC522_SPI_MOSI
            int "MOSI GPIO pin"
            range 0 48
            default 6
            help
                GPIO pin for SPI MOSI.

        config RFID_RC522_SPI_SCLK
            int "SCLK GPIO pin"
            range 0 48
            default 4
            help
                GPIO pin for SPI SCLK.

        config RFID_RC522_SPI_CS
            int "CS GPIO pin"
            range 0 48
            default 10
            help
                GPIO pin for SPI CS.
    endif

endmenu
```

## legacy/fs_tool/Kconfig
```kconfig
menu "Filesystem Tool Configuration"

    config FS_TOOL_DEFAULT_MOUNT_POINT
        string "Default mount point"
        default "/littlefs"
        help
            Default filesystem mount point path.

    config FS_TOOL_DEFAULT_PARTITION_LABEL
        string "Default partition label"
        default ""
        help
            Default LittleFS partition label. Leave empty to use the default partition.

    config FS_TOOL_AUTO_FORMAT
        bool "Auto-format on mount failure"
        default y
        help
            Automatically format the filesystem if mounting fails.

    config FS_TOOL_SPACE_CHECK_INTERVAL_MS
        int "Space check interval (milliseconds)"
        default 30000
        range 5000 300000
        help
            How often to check filesystem space usage and publish events.

    config FS_TOOL_LOW_SPACE_THRESHOLD
        int "Low space warning threshold (percent)"
        default 85
        range 50 95
        help
            Filesystem usage percentage at which to publish low space warnings.

    config FS_TOOL_ENABLE_ATOMIC_OPERATIONS
        bool "Enable atomic file operations"
        default y
        help
            Use temporary files and atomic rename for safer file operations.

    config FS_TOOL_ENABLE_HEALTH_CHECK
        bool "Enable filesystem health monitoring"
        default y
        help
            Enable periodic filesystem health checks and test file creation.

    config FS_TOOL_EVENT_TASK_STACK_SIZE
        int "Event task stack size"
        default 3072
        range 2048 8192
        help
            Stack size for the filesystem monitoring task.

endmenu
```

## legacy/ntp_tool/Kconfig
```kconfig
menu "NTP Tool Configuration"

    config NTP_TOOL_DEFAULT_SYNC_INTERVAL
        int "Default sync interval (seconds)"
        range 60 86400
        default 3600
        help
            Default automatic synchronization interval in seconds.
            Range: 60 seconds (1 minute) to 86400 seconds (24 hours).

    config NTP_TOOL_DEFAULT_TIMEOUT
        int "Default sync timeout (milliseconds)"
        range 1000 30000
        default 10000
        help
            Default timeout for NTP synchronization requests in milliseconds.

    config NTP_TOOL_MAX_RETRY_ATTEMPTS
        int "Maximum retry attempts"
        range 1 10
        default 3
        help
            Maximum number of retry attempts for failed NTP synchronization.

    config NTP_TOOL_RETRY_DELAY
        int "Retry delay (milliseconds)"
        range 500 10000
        default 2000
        help
            Delay between retry attempts in milliseconds.

    config NTP_TOOL_DEFAULT_TIMEZONE
        string "Default timezone"
        default "UTC0"
        help
            Default timezone string (POSIX format).
            Examples:
            - UTC0 (UTC)
            - EST5EDT,M3.2.0,M11.1.0 (US Eastern)
            - PST8PDT,M3.2.0,M11.1.0 (US Pacific)

    config NTP_TOOL_EVENT_TASK_STACK_SIZE
        int "Event task stack size"
        range 2048 8192
        default 4096
        help
            Stack size for NTP tool event handling task.

    config NTP_TOOL_ENABLE_DEBUG_LOGS
        bool "Enable debug logging"
        default n
        help
            Enable detailed debug logging for NTP tool operations.

endmenu
```

## tools/feedback_tool/Kconfig
```kconfig
menu "Feedback Tool Configuration"

    config FEEDBACK_TOOL_LED_GPIO
        int "WS2812B LED GPIO Pin"
        default 7
        range 0 48
        help
            GPIO pin number for the WS2812B LED strip data line.
            Default is GPIO 7 for the time tracker hardware.

    config FEEDBACK_TOOL_MAX_BRIGHTNESS
        int "Maximum LED Brightness"
        default 150
        range 1 255
        help
            Maximum brightness level for the WS2812B LED (1-255).
            Lower values save power and reduce eye strain.

    config FEEDBACK_TOOL_BREATHING_PERIOD_MS
        int "Breathing Period (milliseconds)"
        default 4000
        range 1000 10000
        help
            Duration of one complete breathing cycle for idle state (in ms).
            Default 4000ms provides a calm, slow breathing effect.

    config FEEDBACK_TOOL_QUEUE_SIZE
        int "State Queue Size"
        default 8
        range 4 16
        help
            Maximum number of states that can be queued simultaneously.
            Higher values allow more complex state management.

    config FEEDBACK_TOOL_TASK_STACK_SIZE
        int "Task Stack Size"
        default 4096
        range 2048 8192
        help
            Stack size for the feedback tool background task (in bytes).
            Must be sufficient for LED operations and state management.

    config FEEDBACK_TOOL_TASK_PRIORITY
        int "Task Priority"
        default 5
        range 1 25
        help
            Priority level for the feedback tool task.
            Higher values give more responsive LED updates.

    config FEEDBACK_TOOL_AP_WARNING_FLASH_INTERVAL
        int "AP Mode Warning Flash Interval (ms)"
        default 100
        range 50 500
        help
            Flash interval for yellow warning phase during AP mode fallback.
            Fast flashing (100ms) attracts attention to WiFi configuration needed.
            Total yellow phase duration is 1000ms with this flash pattern.

endmenu
```

## tools/http_tool/Kconfig
```kconfig
menu "HTTP Tool Configuration"

    config HTTP_TOOL_WEBHOOK_URL
        string "Webhook Server URL"
        default "http://nicolasdb.eu/webhook"
        help
            HTTP Tool webhook server URL configuration - single source of truth for webhook endpoint.
            
            Examples:
            - Production: http://nicolasdb.eu/webhook
            - Testing: http://httpbin.org/post
            - Local development: http://192.168.1.100:3000/webhook
            
            Note: HTTPS URLs require proper SSL/TLS configuration.

    config HTTP_TOOL_TIMEOUT_MS
        int "HTTP Request Timeout (milliseconds)"
        default 10000
        range 1000 60000
        help
            Timeout for HTTP requests in milliseconds.
            Recommended: 10000ms (10 seconds) for most webhook servers.

    config HTTP_TOOL_MAX_RETRIES
        int "Maximum Retry Attempts"
        default 3
        range 0 10
        help
            Maximum number of retry attempts for failed HTTP requests.
            Set to 0 to disable retries.

    config HTTP_TOOL_RETRY_DELAY_MS
        int "Retry Delay (milliseconds)"
        default 1000
        range 100 10000
        help
            Delay between retry attempts in milliseconds.


endmenu
```

## tools/network_tool/Kconfig
```kconfig
menu "WiFi Tool Configuration"

    config WIFI_TOOL_MAX_RETRY_ATTEMPTS
        int "Maximum WiFi connection retry attempts"
        default 3
        range 1 10
        help
            Number of connection attempts before falling back to AP mode.
            Lower values = faster fallback for testing and development.
            Higher values = more tolerance for temporary network issues.
            Default 3 attempts provides quick fallback for testing.

    config WIFI_TOOL_CONNECT_TIMEOUT_MS
        int "WiFi connection timeout per attempt (milliseconds)"
        default 10000
        range 3000 60000
        help
            Timeout per connection attempt before trying next network or retrying.
            Lower values = faster testing cycles and quicker AP mode fallback.
            Default 10s provides quick feedback during development.
            Production deployments may want 20-30s for slow networks.

    config WIFI_TOOL_RETRY_DELAY_MS
        int "Delay between retry attempts (milliseconds)"
        default 2000
        range 500 10000
        help
            Delay between connection attempts to avoid overwhelming the network.
            Lower values = faster testing cycles.
            Default 2s provides reasonable rate limiting.

endmenu
```

## tools/ntp_tool/Kconfig
```kconfig
menu "NTP Tool Configuration"

    config SYSTEM_TIMEZONE
        string "Device Timezone Configuration"
        default "UTC0"
        help
            NTP Tool timezone configuration - single source of truth for device timezone.
            Default is set for Belgium/Central European Time (UTC+1) with DST.
            
            Examples:
            - UTC: "UTC0"
            - Central European Time (Belgium): "CET-1CEST,M3.5.0,M10.5.0/3"
            - Pacific Standard Time: "PST8PDT,M3.2.0,M11.1.0"
            - Eastern Standard Time: "EST5EDT,M3.2.0,M11.1.0"
            
            Format: <std><offset><dst>,<start>,<end>
            Where:
            - std: Standard timezone name (3+ chars)
            - offset: Hours offset from UTC (positive = west of UTC)
            - dst: Daylight saving time name (optional)
            - start/end: DST transition rules (optional)

endmenu
```
